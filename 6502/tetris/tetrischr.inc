.segment "CHARS"
;_img1:
    .byte $00,$00,$00,$00,$00,$00,$00,$00,$00,$00,$00,$00,$00,$00,$00,$00 ;0
    .byte $FF,$FF,$C3,$C3,$C3,$C3,$FF,$FF,$01,$03,$3F,$3F,$3F,$3F,$7F,$FF ;1
    .byte $C3,$C3,$C3,$C3,$C3,$C3,$C3,$C3,$3F,$3F,$3F,$3F,$3F,$3F,$3F,$3F ;2
    .byte $FF,$FF,$00,$00,$00,$00,$FF,$FF,$00,$00,$FF,$FF,$FF,$FF,$FF,$FF ;3
    .byte $C3,$C3,$C3,$C3,$C3,$C3,$FF,$FF,$3F,$3F,$3F,$3F,$3F,$3F,$7F,$FF ;4
    .byte $FF,$FF,$C3,$C3,$C3,$C3,$C3,$C3,$01,$03,$3F,$3F,$3F,$3F,$3F,$3F ;5
    .byte $FF,$FF,$03,$03,$03,$03,$FF,$FF,$01,$03,$FF,$FF,$FF,$FF,$FF,$FF ;6
    .byte $FF,$FF,$C0,$C0,$C0,$C0,$FF,$FF,$00,$00,$3F,$3F,$3F,$3F,$7F,$FF ;7
    .byte $FF,$FF,$03,$03,$03,$03,$C3,$C3,$01,$03,$FF,$FF,$FF,$FF,$BF,$3F ;8
    .byte $C3,$C3,$C0,$C0,$C0,$C0,$FF,$FF,$3E,$3C,$3F,$3F,$3F,$3F,$7F,$FF ;9
    .byte $C3,$C3,$03,$03,$03,$03,$FF,$FF,$3F,$3F,$FF,$FF,$FF,$FF,$FF,$FF ;10
    .byte $FF,$FF,$C0,$C0,$C0,$C0,$C3,$C3,$00,$00,$3F,$3F,$3F,$3F,$3F,$3F ;11
    .byte $C3,$C3,$00,$00,$00,$00,$FF,$FF,$3E,$3C,$FF,$FF,$FF,$FF,$FF,$FF ;12
    .byte $C3,$C3,$C0,$C0,$C0,$C0,$C3,$C3,$3E,$3C,$3F,$3F,$3F,$3F,$3F,$3F ;13
    .byte $FF,$FF,$00,$00,$00,$00,$C3,$C3,$00,$00,$FF,$FF,$FF,$FF,$BF,$3F ;14
    .byte $C3,$C3,$03,$03,$03,$03,$C3,$C3,$3F,$3F,$FF,$FF,$FF,$FF,$BF,$3F ;15
;_img2:
    .byte $FF,$FF,$FF,$FF,$FF,$FF,$FF,$FF,$FF,$FF,$FF,$FF,$FF,$FF,$FF,$FF ;black
    .byte $FF,$FF,$FF,$FF,$FF,$FF,$FF,$FF,$36,$56,$56,$36,$76,$76,$76,$79 ;pu
    .byte $FF,$FF,$FF,$FF,$FF,$FF,$FF,$FF,$CD,$B5,$BD,$CC,$F5,$F5,$B5,$CD ;sh
    .byte $FF,$FF,$FF,$FF,$FF,$FF,$FF,$FF,$BD,$BD,$BA,$38,$BA,$BA,$BA,$BA ;a
    .byte $FF,$FF,$FF,$FF,$FF,$FF,$FF,$FF,$ED,$EB,$EB,$E7,$EB,$EB,$ED,$ED ;ke
    .byte $FF,$FF,$FF,$FF,$FF,$FF,$FF,$FF,$0E,$75,$75,$1B,$7B,$7B,$7B,$1B ;y
    .byte $FF,$FF,$FF,$FF,$FF,$FF,$FF,$FF,$CF,$B7,$7B,$7B,$7B,$7B,$B7,$CF ;0
    .byte $FF,$FF,$FF,$FF,$FF,$FF,$FF,$FF,$EF,$CF,$EF,$EF,$EF,$EF,$EF,$C7 ;1
    .byte $FF,$FF,$FF,$FF,$FF,$FF,$FF,$FF,$C7,$BB,$FB,$F7,$EF,$DF,$BF,$83 ;2
    .byte $FF,$FF,$FF,$FF,$FF,$FF,$FF,$FF,$C7,$FB,$FB,$C7,$FB,$FB,$FB,$C7 ;3
    .byte $FF,$FF,$FF,$FF,$FF,$FF,$FF,$FF,$F7,$E7,$D7,$B7,$81,$F7,$F7,$E3 ;4
    .byte $FF,$FF,$FF,$FF,$FF,$FF,$FF,$FF,$83,$BF,$BF,$87,$FB,$FB,$BB,$C7 ;5
    .byte $FF,$FF,$FF,$FF,$FF,$FF,$FF,$FF,$C7,$BB,$BF,$87,$BB,$BB,$BB,$C7 ;6
    .byte $FF,$FF,$FF,$FF,$FF,$FF,$FF,$FF,$C3,$DB,$FB,$F7,$F7,$F7,$F7,$F7 ;7
    .byte $FF,$FF,$FF,$FF,$FF,$FF,$FF,$FF,$C7,$BB,$BB,$C7,$BB,$BB,$BB,$C7 ;8
    .byte $FF,$FF,$FF,$FF,$FF,$FF,$FF,$FF,$C7,$BB,$BB,$C7,$FB,$FB,$FB,$C7 ;9

