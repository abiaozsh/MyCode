


int char_table[] = {
0x00000000,0x00000000,0x00000000,0x00000000, // 0x00
0x00000000,0x00000000,0x00000000,0x00000000, // 0x01
0x00000000,0x00000000,0x00000000,0x00000000, // 0x02
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0x0070D8D8,0x70000000,0x00000000,0x00000000  // 0x7F DEL
};

int x;
int y;
int screen_base;
int screenInited = 0;
int screenInit(int screenBase){
  x = 0;
  y = 0;
  IOWR(VGA, VGA_BASE, screenBase);//1024=2Mbyte
  screen_base = screenBase*2048;
  for(int i=0;i<0x80000;i++){
    ((int*)(screen_base))[i] = 0;//at 2Mbyte
  }
  screenInited = 1;
}
int printScreen(int chr){
  if(screenInited){
    for(int j=0;j<16;j++){
      void* addr;
      for(int i=0;i<8;i++){
        int a = (chr*4) + (j>>2);
        int b = ((3-(j&3))<<3)  +  (7-i);
        //printInt(a);print(" ");
        //printInt(b);print(" ");
        int val = char_table[a]>>( b ) & 1;
        //uart_write('0'+val);print("\r\n");
        int calc_x = x * 8 + i;
        int calc_y = y * 16 + j;
        addr = (void*)(screen_base+(calc_x+calc_y*1024)*2);
        *((short*)(addr)) = val?0xFFFF:0x0000;//at 2Mbyte
      }
      flushCache(addr);
    }
    x++;
    if(x==80 || (chr == 0x0A)){
      x=0;
      y++;
      if(y>=30){
        y=0;
      }
      
      for(int j=0;j<16;j++){
        void* addr;
        for(int i=0;i<1024;i++){
          int calc_x = x * 8 + i;
          int calc_y = y * 16 + j;
          addr = (void*)(screen_base+(calc_x+calc_y*1024)*2);
          *((short*)(addr)) = 0x0000;//at 2Mbyte
        }
        flushCache(addr);
      }
      
    }
  }

}


#define PS2_TAB				9
#define PS2_ENTER			10
#define PS2_BACKSPACE			127
#define PS2_ESC				27
#define PS2_INSERT			0
#define PS2_DELETE			127
#define PS2_HOME			0
#define PS2_END				0
#define PS2_PAGEUP			25
#define PS2_PAGEDOWN			26
#define PS2_UPARROW			11
#define PS2_LEFTARROW			8
#define PS2_DOWNARROW			10
#define PS2_RIGHTARROW			21
#define PS2_F1				0
#define PS2_F2				0
#define PS2_F3				0
#define PS2_F4				0
#define PS2_F5				0
#define PS2_F6				0
#define PS2_F7				0
#define PS2_F8				0
#define PS2_F9				0
#define PS2_F10				0
#define PS2_F11				0
#define PS2_F12				0
#define PS2_SCROLL			0

//int b[1000000];

int PS2Keymap_US[] = {
  // without shift
	0, PS2_F9, 0, PS2_F5, PS2_F3, PS2_F1, PS2_F2, PS2_F12,
	0, PS2_F10, PS2_F8, PS2_F6, PS2_F4, PS2_TAB, '`', 0,
	0, 0 /*Lalt*/, 0 /*Lshift*/, 0, 0 /*Lctrl*/, 'q', '1', 0,
	0, 0, 'z', 's', 'a', 'w', '2', 0,
	0, 'c', 'x', 'd', 'e', '4', '3', 0,
	0, ' ', 'v', 'f', 't', 'r', '5', 0,
	0, 'n', 'b', 'h', 'g', 'y', '6', 0,
	0, 0, 'm', 'j', 'u', '7', '8', 0,
	0, ',', 'k', 'i', 'o', '0', '9', 0,
	0, '.', '/', 'l', ';', 'p', '-', 0,
	0, 0, '\'', 0, '[', '=', 0, 0,
	0 /*CapsLock*/, 0 /*Rshift*/, PS2_ENTER /*Enter*/, ']', 0, '\\', 0, 0,
	0, 0, 0, 0, 0, 0, PS2_BACKSPACE, 0,
	0, '1', 0, '4', '7', 0, 0, 0,
	'0', '.', '2', '5', '6', '8', PS2_ESC, 0 /*NumLock*/,
	PS2_F11, '+', '3', '-', '*', '9', PS2_SCROLL, 0,
	0, 0, 0, PS2_F7 };

int uart_read(int timeout){
  if(timeout!=-1){
    IOWR(MYTIMER, 0 ,0);
  }
  while(1){
    if(timeout!=-1){
      int timer = IORD(MYTIMER, 0);
      if(timer>timeout){
        return -1;
      }
    }
    int tmp = IORD(MYUART, 0);
    if(tmp&0x100){
      return tmp & 0xFF;
    }
    
    tmp = IORD(MYKEYB, 0);
    if(tmp&0x400){
      tmp = (tmp>>1) & 0xFF;
      if(tmp == 0xF0 || tmp ==0xE0)
      {
        uart_read(timeout);
      }
      else{
        return PS2Keymap_US[tmp];
      }
    }
  }
}

int uart_read(){
  uart_read(-1);
}

int uart_write(int val){
  while((IORD(MYUART, 1)) & 0x100);
  IOWR(MYUART, 1 ,val);
  printScreen(val);
}


